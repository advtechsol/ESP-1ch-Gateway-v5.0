#include "heltec_oled.h"

#include <algorithm>
#include <cstring>

namespace {

constexpr uint8_t kDisplayWidth = 128;
constexpr uint8_t kDisplayHeight = 64;
constexpr size_t kBufferSize = (kDisplayWidth * kDisplayHeight) / 8;

// Classic 5x7 font for ASCII 32..127
const uint8_t kFont5x7[96][5] = {
    {0x00,0x00,0x00,0x00,0x00}, // ' '
    {0x00,0x00,0x5F,0x00,0x00}, // '!'
    {0x00,0x07,0x00,0x07,0x00}, // '"'
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    {0x00,0x00,0x00,0x00,0x00}  // DEL (unused)
};

constexpr uint8_t kFontBaseWidth = 5;
constexpr uint8_t kFontBaseHeight = 7;
constexpr uint8_t kFontSpacing = 1;

} // namespace

const HeltecFont Heltec_Arial16 = {kFontBaseWidth, kFontBaseHeight, 2};
const HeltecFont Heltec_Arial24 = {kFontBaseWidth, kFontBaseHeight, 3};

HeltecSSD1306::HeltecSSD1306(uint8_t address, int sdaPin, int sclPin, int rstPin)
    : address_(address), sda_(sdaPin), scl_(sclPin), rst_(rstPin) {
    memset(buffer_, 0, sizeof(buffer_));
}

bool HeltecSSD1306::init() {
    if (initialized_) {
        return true;
    }

    Wire.begin(sda_, scl_);
    Wire.setClock(400000);

    if (rst_ >= 0) {
        pinMode(rst_, OUTPUT);
        digitalWrite(rst_, LOW);
        delay(10);
        digitalWrite(rst_, HIGH);
    }

    writeCommand(0xAE); // display off
    writeCommand(0xD5); // clock divide ratio
    writeCommand(0x80);
    writeCommand(0xA8); // multiplex ratio
    writeCommand(0x3F);
    writeCommand(0xD3); // display offset
    writeCommand(0x00);
    writeCommand(0x40); // start line
    writeCommand(0x8D); // charge pump
    writeCommand(0x14);
    writeCommand(0x20); // memory addressing mode
    writeCommand(0x00); // horizontal addressing mode
    writeCommand(0xA1); // segment remap
    writeCommand(0xC8); // COM scan direction
    writeCommand(0xDA); // COM pins hardware config
    writeCommand(0x12);
    writeCommand(0x81); // contrast control
    writeCommand(0x8F);
    writeCommand(0xD9); // pre-charge period
    writeCommand(0xF1);
    writeCommand(0xDB); // VCOMH deselect level
    writeCommand(0x40);
    writeCommand(0xA4); // resume display
    writeCommand(0xA6); // normal display
    writeCommand(0x2E); // deactivate scroll

    initialized_ = true;

    clear();
    display();
    displayOn();
    return true;
}

void HeltecSSD1306::flipScreenVertically() {
    flipVertical_ = !flipVertical_;
    writeCommand(flipVertical_ ? 0xC0 : 0xC8);
    writeCommand(flipVertical_ ? 0xA0 : 0xA1);
}

void HeltecSSD1306::setFont(const HeltecFont *font) {
    if (!font) {
        return;
    }
    fontScale_ = font->scale == 0 ? 1 : font->scale;
}

void HeltecSSD1306::setTextAlignment(HeltecTextAlignment alignment) {
    alignment_ = alignment;
}

void HeltecSSD1306::clear() {
    memset(buffer_, 0, sizeof(buffer_));
}

void HeltecSSD1306::display() {
    if (!initialized_) {
        return;
    }

    writeCommand(0x21); // column address
    writeCommand(0x00);
    writeCommand(kDisplayWidth - 1);

    writeCommand(0x22); // page address
    writeCommand(0x00);
    writeCommand((kDisplayHeight / 8) - 1);

    size_t sent = 0;
    while (sent < kBufferSize) {
        Wire.beginTransmission(address_);
        Wire.write(0x40);
        uint8_t batch = static_cast<uint8_t>(std::min<size_t>(16, kBufferSize - sent));
        for (uint8_t i = 0; i < batch; ++i) {
            Wire.write(buffer_[sent++]);
        }
        Wire.endTransmission();
    }
}

void HeltecSSD1306::drawString(int16_t x, int16_t y, const String &text) {
    if (!initialized_) {
        return;
    }

    int16_t cursorX = x;
    if (alignment_ != TEXT_ALIGN_LEFT) {
        int16_t charWidth = (kFontBaseWidth + kFontSpacing) * fontScale_;
        int16_t totalWidth = charWidth * text.length();
        if (alignment_ == TEXT_ALIGN_CENTER) {
            cursorX -= totalWidth / 2;
        } else if (alignment_ == TEXT_ALIGN_RIGHT) {
            cursorX -= totalWidth;
        }
    }

    for (size_t i = 0; i < static_cast<size_t>(text.length()); ++i) {
        drawChar(cursorX, y, text.charAt(i));
        cursorX += (kFontBaseWidth + kFontSpacing) * fontScale_;
    }
}

void HeltecSSD1306::displayOn() {
    writeCommand(0xAF);
}

void HeltecSSD1306::displayOff() {
    writeCommand(0xAE);
}

void HeltecSSD1306::drawChar(int16_t x, int16_t y, char c) {
    if (c < 32 || c > 127) {
        c = '?';
    }
    const uint8_t *glyph = kFont5x7[c - 32];

    for (uint8_t col = 0; col < kFontBaseWidth; ++col) {
        uint8_t columnData = glyph[col];
        for (uint8_t row = 0; row < kFontBaseHeight; ++row) {
            bool pixelOn = columnData & (1 << row);
            if (!pixelOn) {
                continue;
            }
            for (uint8_t dx = 0; dx < fontScale_; ++dx) {
                for (uint8_t dy = 0; dy < fontScale_; ++dy) {
                    drawPixel(x + col * fontScale_ + dx,
                              y + row * fontScale_ + dy,
                              true);
                }
            }
        }
    }
}

void HeltecSSD1306::drawPixel(int16_t x, int16_t y, bool on) {
    if (flipVertical_) {
        y = (kDisplayHeight - 1) - y;
    }
    if (x < 0 || x >= kDisplayWidth || y < 0 || y >= kDisplayHeight) {
        return;
    }

    size_t index = x + (y / 8) * kDisplayWidth;
    uint8_t mask = 1 << (y & 0x07);
    if (on) {
        buffer_[index] |= mask;
    } else {
        buffer_[index] &= ~mask;
    }
}

void HeltecSSD1306::writeCommand(uint8_t command) const {
    Wire.beginTransmission(address_);
    Wire.write(0x00);
    Wire.write(command);
    Wire.endTransmission();
}
